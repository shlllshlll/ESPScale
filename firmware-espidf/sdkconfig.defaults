## firmware-espidf/sdkconfig.defaults
```kconfig
# Target chip
CONFIG_IDF_TARGET="esp32c3"

# Flash
CONFIG_ESPTOOLPY_FLASHSIZE_4MB=y

# Partition Table - OTA enabled (3 slots: factory + ota_0 + ota_1)
CONFIG_PARTITION_TABLE_CUSTOM=y
CONFIG_PARTITION_TABLE_CUSTOM_FILENAME="partitions_ota.csv"

# Compiler - optimize for size (reduces binary ~30% vs debug)
CONFIG_COMPILER_OPTIMIZATION_SIZE=y

# WiFi
CONFIG_ESP_WIFI_STATIC_RX_BUFFER_NUM=4
CONFIG_ESP_WIFI_DYNAMIC_RX_BUFFER_NUM=8
CONFIG_ESP_WIFI_RX_BA_WIN=6

# BLE (NimBLE - less memory than Bluedroid)
CONFIG_BT_NIMBLE_ENABLED=y
CONFIG_BT_ENABLED=y
CONFIG_BTDM_CTRL_MODE_BLE_ONLY=y

# MQTT
CONFIG_MQTT_PROTOCOL_311=y

# FreeRTOS
CONFIG_FREERTOS_HZ=1000
CONFIG_FREERTOS_UNICORE=y

# Log level
CONFIG_LOG_DEFAULT_LEVEL_INFO=y
CONFIG_LOG_MAXIMUM_LEVEL_INFO=y

# Stack overflow detection
CONFIG_FREERTOS_CHECK_STACKOVERFLOW=y
CONFIG_FREERTOS_CHECK_STACKOVERFLOW_CANARY=y

# Reduce bootloader log level
CONFIG_BOOTLOADER_LOG_LEVEL_WARN=y

# Disable unused NimBLE services to save code size
# CONFIG_BT_NIMBLE_DIS_SERVICE is not set
# CONFIG_BT_NIMBLE_BAS_SERVICE is not set
# CONFIG_BT_NIMBLE_HR_SERVICE is not set
# CONFIG_BT_NIMBLE_SPS_SERVICE is not set
# CONFIG_BT_NIMBLE_LLS_SERVICE is not set
# CONFIG_BT_NIMBLE_IAS_SERVICE is not set
# CONFIG_BT_NIMBLE_TPS_SERVICE is not set
# CONFIG_BT_NIMBLE_IPSS_SERVICE is not set
# CONFIG_BT_NIMBLE_HTP_SERVICE is not set
# CONFIG_BT_NIMBLE_CTS_SERVICE is not set
# CONFIG_BT_NIMBLE_ANS_SERVICE is not set
# CONFIG_BT_NIMBLE_PROX_SERVICE is not set
# CONFIG_BT_NIMBLE_50_FEATURE_SUPPORT is not set

# Assertions - disable to save flash
CONFIG_COMPILER_OPTIMIZATION_ASSERTIONS_DISABLE=y
```
